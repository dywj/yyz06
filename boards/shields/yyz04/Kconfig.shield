## boards/shields/yyz04/Kconfig.shield
```kconfig
# Copyright (c) 2020 Noir Guo
# SPDX-License-Identifier: MIT

config SHIELD_yyz04_LEFT
    def_bool $(shields_list_contains,yyz04_left)

config SHIELD_yyz04_RIGHT
    def_bool $(shields_list_contains,yyz04_right)
```

## config/west.yml
```yaml
manifest:
  remotes:
    - name: zmkfirmware
      url-base: https://github.com/dywj
  projects:
    - name: zmk
      remote: zmkfirmware
      revision: yyz1
      import: app/west.yml
  self:
    path: config
```
